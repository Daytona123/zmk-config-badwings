## config/boards/shields/bad_wings/boards/seeeduino_xiao_ble.conf
```kconfig
CONFIG_ZMK_MOUSE=y
CONFIG_ZMK_BLE_EXPERIMENTAL_CONN=y
CONFIG_SPI=y
CONFIG_ZMK_SLEEP=y
# Turn on logging, and set ZMK logging to debug output
CONFIG_ZMK_USB_LOGGING=n
```

## config/west.yml
```yaml
manifest:
  remotes:
    - name: zmkfirmware
      url-base: https://github.com/zmkfirmware
  projects:
    # - name: zmk
    #   remote: zmkfirmware
    #   revision: main
    #   import: app/west.yml
    - name: zmk
      remote: zmkfirmware
      revision: feat/pointers-move-scroll
      import: app/west.yml
    - name: cirque-input-module
      remote: zmkfirmware
      revision: main
  self:
    path: config
```
